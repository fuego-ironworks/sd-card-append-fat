## fs/appendfat/Kconfig
```kconfig
# SPDX-License-Identifier: GPL-2.0-only
config APPENDFAT_FS
	tristate
	select BUFFER_HEAD
	select NLS
	select LEGACY_DIRECT_IO
	help
	  Common FAT-compatible core for the separately registered appendfat
	  filesystem derivatives. This starts from the pinned Linux FAT baseline;
	  append-specific allocation policy is intentionally not introduced here.

config APPENDFAT_MSDOS_FS
	tristate "appendfat MS-DOS name support"
	select APPENDFAT_FS
	help
	  Build the legacy 8.3-name derivative under the independent filesystem
	  name "appendmsdos". This preserves the baseline MS-DOS FAT behavior while
	  keeping stock Linux "msdos" separately selectable.

	  To compile this as a module, choose M here: the module is appendmsdos.

config APPENDFAT_VFAT_FS
	tristate "appendfat VFAT long-name support"
	select APPENDFAT_FS
	help
	  Build the long-filename FAT derivative under the independent filesystem
	  name "appendfat". At this stage its FAT behavior is intended to remain
	  identical to the pinned Linux VFAT baseline.

	  To compile this as a module, choose M here: the module is appendfat.

config APPENDFAT_DEFAULT_CODEPAGE
	int "Default codepage for appendfat"
	depends on APPENDFAT_FS
	default 437
	help
	  Default FAT codepage. It can be overridden with the codepage mount option.

config APPENDFAT_DEFAULT_IOCHARSET
	string "Default iocharset for appendfat"
	depends on APPENDFAT_VFAT_FS
	default "iso8859-1"
	help
	  Default input/output character set for appendfat long filenames. It can
	  be overridden with the iocharset mount option.

config APPENDFAT_DEFAULT_UTF8
	bool "Enable appendfat UTF-8 option by default"
	depends on APPENDFAT_VFAT_FS
	default n
	help
	  Enable the existing VFAT utf8 mount behavior by default for appendfat.

config APPENDFAT_KUNIT_TEST
	tristate "Unit tests for appendfat" if !KUNIT_ALL_TESTS
	depends on KUNIT && APPENDFAT_FS
	default KUNIT_ALL_TESTS
	help
	  Build the inherited FAT KUnit tests against the appendfat namespace.
```
